## drivers/clk/realtek/Kconfig
```kconfig
menuconfig COMMON_CLK_RTK
    bool "Clock driver for realtek"
    depends on ARCH_RTD129x
    default y

config COMMON_CLK_RTD129x
    bool "Clock driver for RTD129x"
    depends on COMMON_CLK_RTK
    default y

config COMMON_CLK_RTD129x_DEBUGFS
    bool "DebugFs for RTD129x clock driver"
    depends on DEBUG_FS && COMMON_CLK_RTD129x
```

## drivers/media/platform/rtk_hdcptx/Kconfig
```kconfig
config RTK_HDCP_1x
	tristate "HDCP TX 1.x for Realtek RTD1295 platform"
	select I2C
	select SWITCH
	default n
	help
	  Say Y, if you want to enable HDCP TX 1.x feature on Realtek RTD1295 platform.
```

## drivers/media/platform/rtk_hdmirx/Kconfig
```kconfig
config RTK_HDMIRX
	tristate "HDMIRX for Realtek RTD1295 platform"
	select MEDIA_CAMERA_SUPPORT
	select VIDEO_DEV
	select I2C
	select VIDEO_V4L2
	select VIDEOBUF2_CORE
	select VIDEOBUF_GEN
	select VIDEOBUF2_VMALLOC
	select VIDEOBUF2_DMA_CONTIG
	default n
	---help---
	  Say Y, if you want to enable HDMI RX driver on Realtek RTD1295 platform.
```

## drivers/powerctrl/Kconfig
```kconfig
menu "Power Control"

config POWER_CONTROL
    bool "Power Control Support"
    default y


config POWER_CONTROL_DEBUGFS
    bool "DebugFs fpr Power Control"
    depends on POWER_CONTROL
    default n


config POWER_CONTROL_RTD129x
    bool "Power Control for RTD192x"
    depends on POWER_CONTROL
    default y
    

config POWER_CONTROL_RTD129x_DEBUGFS
    bool "DebugFs for RTD192x Power Control"
    depends on POWER_CONTROL_RTD129x
    default y

endmenu
```

## drivers/soc/realtek/rtd129x/Kconfig
```kconfig
comment "RTD129x Device Drivers"

menu "RTD129x Device Drivers"

config RTK_SB2_MEM_TRASH_MONITOR
	bool "Memory trash monitor"
	default n
	help
	  Enable helper functions for memory trash detection. If unsure, say N.

config RTK_RBUS_BARRIER
	bool "R-bus barrier"
	depends on RTK_MEM_REMAP
	default y
	help
	  Enable helper functions for R-bus barrier. If unsure, say N.

config RTK_MEM_REMAP
	bool "Memory remap"
	default y
	help
	  Enable helper functions for static ioremap. If unsure, say N.

#Add your device driver config in here.
config RTK_MCP
	bool "MCP driver"
	default n
	help
	  Realtek MCP driver

config RTK_FAN
	bool "RTK Fan driver"
	default n
	help
	  Realtek Fan driver

source "drivers/soc/realtek/rtd129x/rtk_ve/Kconfig"
source "drivers/soc/realtek/rtd129x/irda/Kconfig"
source "drivers/soc/realtek/rtd129x/rpc/Kconfig"
source "drivers/soc/realtek/rtd129x/hw_nat/Kconfig"
          
endmenu #RTD129x Device Drivers
```

## drivers/soc/realtek/rtd129x/hw_nat/Kconfig
```kconfig
menuconfig RTD_1295_HWNAT
	bool "Realtek HW NAT Driver"
	depends on NET
	select RTL_819X
	select RTL_8197F
	select 8198_PORT5_GMII
	select CPU_LITTLE_ENDIAN
	select HARDWARE_NAT_DEBUG
	select RTL_819X_SWCORE
	select RTL_PROC_NEW
	default n
	---help---
	  You can say N here if you don't intend to use Realtek HW NAT at all.

	  You'll have to say Y if only HW NAT is used for your router.

	  If unsure, say N.

if RTD_1295_HWNAT

config RTL_819X
	bool
	default n

config RTL_8197F
	bool
	default y

config 8198_PORT5_GMII
	bool
	default n

config CPU_LITTLE_ENDIAN
	bool
	default n

config RTL_PROC_NEW
	bool
	default y

config RTL_8367R_SUPPORT
	bool
	default n

config RTL_8198C_8367RB
	bool
	default n

config RTL_8325D_SUPPORT
	bool
	default n

config RTL_SWITCH_NEW_DESCRIPTOR
	bool
	default n

config RTL_ETH_PRIV_SKB
	bool
	default n

config RTL_HW_TX_CSUM
	bool
	default n

config RTL_HTTP_REDIRECT
	bool
	default n

config RTL_HTTP_REDIRECT_LOCAL
	bool
	default n

config RTL_DNS_TRAP
	bool
	default n

config HARDWARE_NAT_DEBUG
	bool
	default n

config RTL_819X_SWCORE
	bool
	default y

config FPGA_V6_HWNAT
	bool
	default n

config DEFAULTS_KERNEL_2_6
	bool
	default y

config AUTO_DHCP_CHECK
	bool "Auto DHCP Check"
	default n

config NEW_PCI
	bool
	default y
	depends on PCI

config RTL_IGMP_PROXY
	bool
	default y

config RTL_IGMP_SNOOPING
	bool
	default n
	depends on BRIDGE

config RTL_MLD_SNOOPING
	bool
	default y
	depends on RTL_IGMP_SNOOPING

config RTL_QUERIER_SELECTION
	bool
	default y
	depends on RTL_IGMP_SNOOPING

config RTL_MLD_PROXY
	bool
	default y

config RTL_LINKCHG_PROCESS
	bool
	default y

config RTL_DEBUG_TOOL
	bool
	default y

menu "Config for Layered Driver Features"
	config RTL_LAYERED_DRIVER
		bool
	        default y
		depends on RTL_819X

	config RTL_LAYERED_ASIC_DRIVER
		bool
		default n
		depends on RTL_LAYERED_DRIVER

	config RTL_LAYERED_ASIC_DRIVER_L3
		bool
		default n
		depends on RTL_LAYERED_ASIC_DRIVER

	config RTL_LAYERED_ASIC_DRIVER_L4
		bool
		default n
		depends on RTL_LAYERED_ASIC_DRIVER
		depends on RTL_8198 || RTL_8196CT || RTL_8198T || RTL_8198C || RTL_8197F

	config RTL_LAYERED_DRIVER_ACL
		bool
		default n
		depends on RTL_LAYERED_DRIVER

	config RTL_LAYERED_DRIVER_L2
		bool
		default n
		depends on RTL_LAYERED_DRIVER

	config RTL_HW_QOS_SUPPORT
		bool
		default n
		depends on RTL_LAYERED_DRIVER
		depends on RTL_8196CT || RTL_8198T || RTL_8198 || RTL_819XDT || RTL_8198C || RTL_8197F

	config RTL_LAYERED_DRIVER_L3
		bool
		default n
		depends on RTL_LAYERED_DRIVER


	config RTL_LAYERED_DRIVER_L4
		bool
		default n
		depends on RTL_LAYERED_DRIVER
		depends on RTL_8198 || RTL_8196CT || RTL_8198T || RTL_8198C || RTL_8197F

	comment 'Choose basic features.'

	config RTL_LINKCHG_PROCESS
		bool
		default n
		depends on RTL_LAYERED_DRIVER

	config RTL_EXTPORT_VLANID
		int
		default "9"
		depends on RTL_LAYERED_DRIVER

	comment 'Choose hardware features.'

	choice
		prompt "Hardware Features Selection"
		default RTL_HW_NAPT
		depends on RTL_LAYERED_DRIVER

	config RTL_HW_NAPT
		bool "Enable RTL Hardware NAPT"
		depends on RTL_8198 || RTL_8196CT || RTL_8198T || RTL_819XDT || RTL_8367R_SUPPORT || RTL_89xxD || RTL_8196C || RTL_8196E || RTL_8198C || RTL_8197F
		select RTL_LAYERED_ASIC_DRIVER
		select RTL_LAYERED_ASIC_DRIVER_L3
		select RTL_LAYERED_ASIC_DRIVER_L4
		select RTL_LAYERED_DRIVER_ACL
		#select RTL_HW_QOS_SUPPORT
		select RTL_LAYERED_DRIVER_L2
		select RTL_LAYERED_DRIVER_L3
		select RTL_LAYERED_DRIVER_L4
		select RTL_HARDWARE_MULTICAST if RTL_IGMP_SNOOPING
		select RTL_HARDWARE_NAT

	config RTL_HW_MULTICAST_ONLY
		bool "Enable RTL Hardware Multicast Only"
		depends on !RTL_8370_SUPPORT
		select RTL_LAYERED_ASIC_DRIVER
		select RTL_LAYERED_ASIC_DRIVER_L3
		select RTL_LAYERED_DRIVER_ACL
		select RTL_LAYERED_DRIVER_L2
		select RTL_LAYERED_DRIVER_L3
		select RTL_HARDWARE_MULTICAST

	config RTL_HW_L2_ONLY
		bool "Enable RTL Hardware switch Only"
		select RTL_LAYERED_ASIC_DRIVER
		select RTL_LAYERED_DRIVER_ACL		#because mld snooping need add acl to trap ipv6 multicast packet to cpu
		select RTL_LAYERED_DRIVER_L2

	endchoice

	comment 'Choose advance features.'

	#config RTL_HW_MCAST_PATCH_FOR_MAC
	#		 #bool "RTL Hardware Multicast patch for Mac address"
	#		 default y
	#	 depends on RTL_HARDWARE_MULTICAST
	#		 depends on RTL_8196E || RTL_8881A || RTL_8198C || RTL_8197F

	config RTL_HW_MCAST_WIFI
			bool "Support hw multiast for eth+wlan client"
		depends on RTL_HARDWARE_MULTICAST

	config RTL_EXT_PORT_SUPPORT
		bool "Enable extension port support"
		default n
		depends on RTL_HW_NAPT
	config RTL_NETIF_MAPPING
				bool "Enable linux ps vs rtl819x driver netif mapping"
		default y
		depends on RTL_LAYERED_DRIVER

	config RTL_MULTIPLE_WAN
		bool "Enable multiple wan in hw nat mode"
		default n
		depends on RTL_NETIF_MAPPING && RTL_HARDWARE_NAT
		depends on RTL_8198T || RTL_8196CT || RTL_819XDT || RTL_8198C || RTL_8197F

	config RTL865X_LANPORT_RESTRICTION
		bool "Rtl865x lan port restriction"
		default n
		depends on RTL_LAYERED_DRIVER

	config RTL_QOS_VLANID_SUPPORT
		bool "HW Qos support vlan id"
		default n
		depends on RTL_HW_QOS_SUPPORT

	config RTL_IVL_SUPPORT
		bool "Support multi-vlan in bridge/wisp mode"
		default n
		depends on RTL_LAYERED_DRIVER && !RTL_8370_SUPPORT

	#config RTL_LOCAL_PUBLIC
	#	bool "Enable RTL local public"
	#	default n
	#	depends on RTL_HW_NAPT

	config RTL_HW_DSLITE_SUPPORT
		bool "Enable HW DS-LITE SUPPORT"
			default n
			depends on RTL_LAYERED_DRIVER

	config RTL_HW_6RD_SUPPORT
		bool "Enable HW 6RD SUPPORT"
			default n
			depends on RTL_LAYERED_DRIVER

	config RTL_TSO
		bool "Enable hardware TSO support"
		default n
		depends on RTL_8197F

#	config RTL_HW_TX_CSUM
#		bool "Enable Ethernet hardware Tx checksum offload"
#		default n
#		depends on RTL_8198C

#	config RTL_ETH_TX_SG
#		bool "Enable Ethernet TX SG support"
#		default n
#		depends on RTL_8198C

endmenu

#config RTK_KERNEL_MIPS16
#        bool "Encode Kernel Code with MIPS16 Instruction Set"
#        default y
#        depends on RTL_819X

config RTL_IPTABLES_RULE_2_ACL
	bool "Enable iptables rule to RTL ACL rule"
	default n
	depends on RTL_LAYERED_DRIVER_ACL

config RTL_FAST_FILTER
	bool "Enable realtek fast filter"
	default n
	depends on RTL_819X

config RTL865X_MBUF_HEADROOM
	int
	range 0 256
	default "128"
	depends on RTL_819X

config RTL_ETH_PRIV_SKB
	bool "Enable Ethernet Private Skb"
	default n
	depends on RTL_819X

config RTL_ETH_PRIV_SKB_DEBUG
	bool "Enable Dump Ethernet Private Skb Info"
	default n
	depends on RTL_ETH_PRIV_SKB

config EXTRTL8212_PHYID_P1
	int
	default "18"
	depends on RTL_819X

config EXTRTL8212_PHYID_P3
	int
	default "20"
	depends on RTL_819X

config EXTRTL8212_PHYID_P5
	int
	default "22"
	depends on RTL_819X


config RTL_HW_QOS_SUPPORT
	bool "Support HW Qos"
	default n
	depends on RTL_LAYERED_DRIVER
	depends on RTL_HARDWARE_NAT
	depends on RTL_8196CT || RTL_8198T || RTL_8198 || RTL_819XDT || RTL_8196C || RTL_8196E || RTL_8198C || RTL_8197F

config RTL_QOS_PATCH
	bool "HW QoS patch"
	default n
	depends on RTL_HW_QOS_SUPPORT

config RTL_HW_QOS_SUPPORT_WLAN
	bool "HW QoS Support Wlan Session"
	default n
	depends on RTL_HW_QOS_SUPPORT

config RTL_SW_QUEUE_DECISION_PRIORITY
	bool "HW QoS sw queue decision priority patch"
	default n
	depends on RTL_HW_QOS_SUPPORT

config RTL_HW_QOS_BRIDGE_FWD_SUPPORT
	bool "HW QoS bridge forward config support"
	default n
	depends on RTL_HW_QOS_SUPPORT

config RTL_HARDWARE_MULTICAST
	bool
	default n
	depends on RTL_LAYERED_DRIVER
	depends on RTL_IGMP_SNOOPING

config RTL_HARDWARE_MULTICAST_CAM
	bool "HW multicast cam support"
	default n
	depends on RTL_LAYERED_DRIVER
	depends on RTL_HARDWARE_MULTICAST
	depends on RTL_8196E || RTL_819XD

config RTL_HARDWARE_NAT
	bool
	default n
	depends on RTL_819X
	depends on RTL_8196CT || RTL_8198 || RTL8198T || RTL_8198C || RTL_8197F

#config RTL865x_TCPFLOW_NONE_STATUS_CHECK
#	bool "Create HW NAT Entry without checking tcp flow status (For SMB/IXIA tcp test)"
#	default n
#	depends on RTL865X_HARDWARE_NAT

config RTL_PPPOE_HWACC
	bool
	default y
	depends on RTL_HARDWARE_NAT

config RTL865X_HW_PPTPL2TP
	bool
	default n
	depends on RTL_HARDWARE_NAT

config RTL_HARDWARE_IPV6_SUPPORT
	bool "Enable hardware ipv6 support"
	default n
	depends on RTL_8198C || RTL_8197F
	depends on IPV6

config RTL_PROC_DEBUG
	bool "Enable proc filesystem for debug"
	default y
	depends on RTL_819X

config RTL_JUMBO_FRAME
	bool "Enable JUMBO frame support"
	default n
	depends on RTL_819X

config RTL_LOG_DEBUG
	bool "Enable log print system for debug"
	default n

config RTL865X_ROMEPERF
	bool "Enable rome perf"
	default n
	depends on RTL_8196C || RTL_8198 || RTL_819XD || RTL_8196E || RTL_8881A

config RTL_ROMEPERF_24K
	bool "Enable rome perf"
	default n
	depends on RTL_8197F


config RTK_VLAN_SUPPORT
	bool "Support rtk vlan feature"
	default n
	depends on RTL_819X && !RTL_8370_SUPPORT

config RTK_VLAN_WAN_TAG_SUPPORT
	bool "Support rtk vlan wan tag feature"
	default n
	depends on RTK_VLAN_SUPPORT`
	depends on RTL_819X

config RTK_VLAN_FOR_CABLE_MODEM
	bool "rtk vlan for cable modem"
	default n
	depends on RTK_VLAN_SUPPORT

config RTK_BRIDGE_VLAN_SUPPORT
	bool "add rtk vlan bridge feature"
	default n
	depends on RTK_VLAN_SUPPORT

config RTL_HW_VLAN_SUPPORT
	bool "Support rtl hw vlan feature"
	default n
	depends on RTK_VLAN_SUPPORT
	depends on RTL_8196CT || RTL_8198T || RTL_8198C || RTL_8197F || RTL_819XD || RTL_8196E

config RTL_VLAN_PASSTHROUGH_SUPPORT
	bool "Support transparent transmission vlan feature"
	default n
	depends on RTL_819X

#config NMS
#	bool "Enable NMS"
#	default n
#	depends on MESH_ENABLE

#config TEST_PKG
#	bool "Test Package(test_traffic ...)"
#	default n
#	depends on MESH_ENABLE

#config 11S_TEST_MODE
#	bool "Enable 11s Test Mode"
#	default n
#	depends on MESH_ENABLE

#config RTK_SUPPORT_DHCP_PORT_IP_BIND
#	bool "Support dhcp ip and port bind"
#	default n
#	depends on RTL_819X

config RTL_UNKOWN_UNICAST_CONTROL
	bool
	default n
	depends on RTL_819X

config RTL_ENABLE_RATELIMIT_TABLE
	bool
	default y
	depends on RTL_UNKOWN_UNICAST_CONTROL

config RTL_MULTI_LAN_DEV
	bool "Multiple lan dev support"
	default y
	depends on RTL_8198C || RTL_8197F

config RTL_EEE_DISABLED
	bool "Disable 802.3az EEE feature"
	default n
	depends on RTL_819X && !RTL_8370_SUPPORT
#	depends on RTL_8196C || RTL_8198 || RTL_819XD || RTL_8196E || RTL_8881A

config RTL_REINIT_SWITCH_CORE
	bool "Support reinit switch core"
	default n
	depends on RTL_8196C || RTL_819XD || RTL_8196E || RTL_8198C

config RTL_CHECK_SWITCH_TX_HANGUP
	bool "Support switch tx hangup check"
	default n
	depends on RTL_REINIT_SWITCH_CORE

config RTL_SOCK_DEBUG
	bool "Enable Dump Socket Buffer Info"
	default n

config RTL_ETH_802DOT1X_SUPPORT
	bool "Rtl ethernet 802.1x support"
	default n
	depends on RTL_819X
	depends on RTL_LAYERED_DRIVER

config RTL_ETH_802DOT1X_CLIENT_MODE_SUPPORT
	bool "Rtl ethernet 802.1x client mode support"
	default n
	depends on RTL_819X
	depends on RTL_LAYERED_DRIVER
	depends on RTL_ETH_802DOT1X_SUPPORT

config RTL_96E_GPIOB5_RESET
	bool "Enable GPIOB5 as Reset Button"
	default n
	depends on RTL_8196E

#config RTL_INBAND_CTL_ACL
#        bool "Enable inband control ACL"
#        default n

config RTL_GIGA_LITE_ENABLED
	bool "Enable Giga Lite support"
	default n
	depends on RTL_8198C
#config RTL_ISP_MULTI_WAN_SUPPORT
#	bool "Enable ISP multi wan support"
#	default n

config RTL_REDIRECT_ACL_SUPPORT_FOR_ISP_MULTI_WAN
	bool "Enable redirect acl support for ISP multi wan"
	default n
	depends on RTL_ISP_MULTI_WAN_SUPPORT
	depends on RTL_HW_NAPT

#config RTL_IGMP_PROXY_MULTIWAN
#	bool "Enable igmpproxy for multi wan"
#	default n
#	depends on RTL_ISP_MULTI_WAN_SUPPORT
#	depends on RTL_IGMP_PROXY

#config RTL_ISP_MULTIPLE_BR_SUPPORT
#        bool "Enable multiple bridge support for igmp snooping"
#        default n
#        depends on RTL_ISP_MULTI_WAN_SUPPORT
#        depends on RTL_IGMP_SNOOPING

config RT_MULTIPLE_BR_SUPPORT
	bool
	default y
	depends on RTL_IGMP_SNOOPING && VLAN_8021Q


config RTL_MULTICAST_PORT_MAPPING
	bool
	default y
	depends on RT_MULTIPLE_BR_SUPPORT

#config RTL_BRSHORTCUT_LINUX_VLAN_CTL
#        bool "enable br shortcut when linux vlan enable"
#        default n
#        depends on RTL_VLAN_8021Q

#config RTL_EXCHANGE_PORTMASK
#        bool "exchange portmask from left to right is wan lan1 lan2 lan3 lan4"
#        default n

#config RTL_INBAND_CTL_API
#	bool "enable inband control api"
#	default n

#config RTL_INBAND_CTL_ACL
#	bool "Enable inband control ACL"
#	default n

config RTD_1295_MAC0_SGMII_LINK_MON
	bool "Polling MAC0 link status"
	default y
	depends on RTD_1295_HWNAT
	---help---
	  You can say N here if you could get interrupt event when MAC0 link change.

	  You'll have to say Y if MDC/MDIO for MAC0 SGMII mode is broken.

	  If unsure, say Y.

config 8198C_8211FS
		bool "Enable 8211FS support"
		default n
	depends on RTL_8198C

config RTL_8211F_SUPPORT
	bool "Enable RTL8211F support"
	default n
	depends on RTL_8197F

config RTL_8367R_SUPPORT
	bool "Enable RTL8367RB support"
	default n
	depends on RTL_8197F

endif
#endmenu
#============================= End of Kconfig ===============================#
```
